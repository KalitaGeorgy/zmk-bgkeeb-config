## boards/shields/bgkeeb/Kconfig.defconfig
```kconfig
if SHIELD_BGKEEB_LEFT

config ZMK_KEYBOARD_NAME
    default "bgkeeb"

endif


if SHIELD_BGKEEB_RIGHT

config ZMK_SPLIT_ROLE_CENTRAL
    default y

config SPI
    default y

config ZMK_POINTING
    default y

endif


if SHIELD_BGKEEB_LEFT || SHIELD_BGKEEB_RIGHT

config ZMK_SPLIT
    default y

endif


if ZMK_BACKLIGHT

config PWM
    default y

config LED_PWM
    default y

endif # ZMK_BACKLIGHT
```
